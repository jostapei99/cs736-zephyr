## CMakeLists.txt
```
cmake_minimum_required(VERSION 3.20.0)

find_package(Zephyr REQUIRED HINTS $ENV{ZEPHYR_BASE})
project(jack_test)

target_sources(app PRIVATE 
    src/main.c
    src/critical_tasks.c
    src/timing_analysis.c
)

target_include_directories(
    app PRIVATE src
)
```

## prj.conf
```kconfig
# Jack Test Project Configuration

CONFIG_LOG=y
# CONFIG_LOG_DEFAULT_LEVEL=4
CONFIG_LOG_PRINTK=y
CONFIG_LOG_BUFFER_SIZE=2048

# Enable kernel debugging and stack initialization
CONFIG_INIT_STACKS=y
CONFIG_THREAD_STACK_INFO=y

# Scheduler configuration
CONFIG_SCHED_SIMPLE=n
CONFIG_SCHED_SCALABLE=y
CONFIG_SCHED_MULTIQ=y
CONFIG_NUM_COOP_PRIORITIES=16
CONFIG_NUM_PREEMPT_PRIORITIES=16

# Enable thread monitoring
CONFIG_THREAD_MONITOR=y
CONFIG_THREAD_NAME=y
CONFIG_THREAD_RUNTIME_STATS=y

# Enable precise timing
CONFIG_SYS_CLOCK_HW_CYCLES_PER_SEC=1000000
CONFIG_TICKLESS_KERNEL=y

# Memory pool configuration
CONFIG_HEAP_MEM_POOL_SIZE=16384

# Enable debugging features
CONFIG_DEBUG=y
CONFIG_DEBUG_OPTIMIZATIONS=y
CONFIG_ASSERT=y

# Enable workqueue for background tasks
CONFIG_SYSTEM_WORKQUEUE_STACK_SIZE=2048

# Console and shell
CONFIG_CONSOLE=y
CONFIG_UART_CONSOLE=y
CONFIG_SERIAL=y

# Enable timing functions
CONFIG_TIMING_FUNCTIONS=y

# Enable kernel events
CONFIG_EVENTS=y
```

## src/main.c
```c
/*
    Mission Critical Scheduler Simulation

    This applicaion simulates mission-critical real-time tasks with various
    priorities and deadlines to analyze scheduler behavior.
*/

#include <zephyr/kernel.h>
#include <zephyr/logging/log.h>
#include <zephyr/timing/timing.h>
#include <zephyr/sys/printk.h>
#include <zephyr/kernel_version.h>
#include <zephyr/random/random.h>
#include <zephyr/kernel_version.h>
#include "mission_critical.h"

LOG_MODULE_REGISTER(mission_critical, LOG_LEVEL_DBG);


// external function declarations
extern void init_critical_tasks(void);
extern void start_timing_analysis(void);
extern void log_scheduler_state(void);

// Mission control task - highest priority
K_THREAD_DEFINE(mission_control_tid, TASK_STACK_SIZE,
                mission_control_task, NULL, NULL, NULL,
                CRITICAL_TASK_PRIORITY, 0, 0);

// Navigation task - high priority
K_THREAD_DEFINE(navigation_tid, TASK_STACK_SIZE,
                navigation_task, NULL, NULL, NULL,
                HIGH_PRIORITY_TASK, 0, 0);

// Communication task - medium priority
K_THREAD_DEFINE(communication_tid, TASK_STACK_SIZE,
                communication_task, NULL, NULL, NULL,
                MEDIUM_PRIORITY_TASK, 0, 0);

// Housekeeping task - low priority
K_THREAD_DEFINE(housekeeping_tid, TASK_STACK_SIZE,
                housekeeping_task, NULL, NULL, NULL,
                LOW_PRIORITY_TASK, 0, 0);

// Shared resources and synchronization
K_MUTEX_DEFINE(resource_mutex);
K_SEM_DEFINE(task_sync_sem, 0, 4);

static uint32_t simulation_start_time;
volatile bool simulation_running = true;

void mission_control_task(void *arg1, void *arg2, void *arg3)
{
    ARG_UNUSED(arg1);
    ARG_UNUSED(arg2);
    ARG_UNUSED(arg3);

    uint32_t cycle_count = 0;
    timing_t start_time, end_time;
    uint64_t execution_time;

    LOG_INF("Mission Control Task started - Priority: %d", CRITICAL_TASK_PRIORITY);

    while (simulation_running) {
        timing_start();
        start_time = timing_counter_get();
        
        LOG_DBG("Mission Control: Cycle %u - Critical safety check", cycle_count);

        // simulate critical mission control operations
        k_busy_wait(5000); // 5ms of critical processing

        // Log scheduler context
        LOG_INF("MC: Thread %p executing at cycle %u", k_current_get(), cycle_count);

        // check for deadline adherence
        end_time = timing_counter_get();
        execution_time = timing_cycles_to_ns(end_time - start_time);
        
        if (execution_time > (DEADLINE_MS * 1000000 / 2)) {
            LOG_WRN("Mission Control: Potential deadline miss! Execution: %llu ns", 
                    execution_time);
        }
        
        timing_stop();
        
        cycle_count++;
        k_msleep(50); // 20Hz execution rate
    }
    
    LOG_INF("Mission Control Task completed %u cycles", cycle_count);
}

void navigation_task(void *arg1, void *arg2, void *arg3)
{
    ARG_UNUSED(arg1);
    ARG_UNUSED(arg2);
    ARG_UNUSED(arg3);

    uint32_t nav_updates = 0;
    
    LOG_INF("Navigation Task started - Priority: %d", HIGH_PRIORITY_TASK);

    while (simulation_running) {
        LOG_DBG("Navigation: Updating position estimate %u", nav_updates);
        
        // Simulate navigation processing
        if (k_mutex_lock(&resource_mutex, K_MSEC(100)) == 0) {
            k_busy_wait(4000); // 4ms of navigation calculations
            
            LOG_INF("NAV: Position updated - Thread %p", k_current_get());
            
            k_mutex_unlock(&resource_mutex);
        } else {
            LOG_WRN("Navigation: Failed to acquire resource mutex!");
        }
        
        nav_updates++;
        k_msleep(75); // ~13Hz navigation updates
    }
    
    LOG_INF("Navigation Task completed %u updates", nav_updates);
}

void communication_task(void *arg1, void *arg2, void *arg3)
{
    ARG_UNUSED(arg1);
    ARG_UNUSED(arg2);
    ARG_UNUSED(arg3);

    uint32_t messages_sent = 0;
    
    LOG_INF("Communication Task started - Priority: %d", MEDIUM_PRIORITY_TASK);

    while (simulation_running) {
        LOG_DBG("Communication: Sending telemetry message %u", messages_sent);

        // Simulate communication overhead
        k_busy_wait(3000 + sys_rand32_get() % 5000); // 3-8ms variable processing
        
        LOG_INF("COMM: Message %u transmitted - Thread %p", 
                messages_sent, k_current_get());
        
        messages_sent++;
        
        // Signal task synchronization
        k_sem_give(&task_sync_sem);
        
        k_msleep(200); // 5Hz communication rate
    }
    
    LOG_INF("Communication Task sent %u messages", messages_sent);
}

void housekeeping_task(void *arg1, void *arg2, void *arg3)
{
    ARG_UNUSED(arg1);
    ARG_UNUSED(arg2);
    ARG_UNUSED(arg3);

    uint32_t housekeeping_cycles = 0;
    
    LOG_INF("Housekeeping Task started - Priority: %d", LOW_PRIORITY_TASK);

    while (simulation_running) {
        LOG_DBG("Housekeeping: Performing maintenance cycle %u", housekeeping_cycles);
        
        // simulate various housekeeping operations
        k_busy_wait(2000); // 2ms of housekeeping
        
        LOG_INF("HOUSE: Maintenance completed - Thread %p", k_current_get());
        
        housekeeping_cycles++;
        k_msleep(1000); // 1Hz housekeeping rate
    }
    
    LOG_INF("Housekeeping Task completed %u cycles", housekeeping_cycles);
}

void log_scheduler_state(void)
{
    struct k_thread *current = k_current_get();
    int raw_prio = current->base.prio;
    const char* thread_type;
    
    // Interpret Zephyr's internal priority representation
    if (raw_prio < 0) {
        thread_type = "COOPERATIVE";
    } else if (raw_prio <= 15) {
        thread_type = "PREEMPTIVE";
    } else {
        thread_type = "SYSTEM/IDLE";
    }
    
    LOG_INF("Scheduler State: Current Thread %p, Priority %d (%s)",
            current, raw_prio, thread_type);
}

static void simulation_timer_handler(struct k_timer *timer)
{
    ARG_UNUSED(timer);

    uint32_t elapsed = k_uptime_get_32() - simulation_start_time;

    LOG_INF("Simulation Time Elapsed: %u seconds", elapsed / 1000);
    log_scheduler_state();

    if (elapsed >= (SIMULATION_DURATION_SEC * 1000)) {
        simulation_running = false;
        LOG_INF("Simulation duration reached. Stopping all tasks.");
    }
}

K_TIMER_DEFINE(simulation_timer, simulation_timer_handler, NULL);

int main(void)
{
    LOG_INF("=== Mission Critical Scheduler Simulation Starting ===");
    LOG_INF("Zephyr kernel version: %u", sys_kernel_version_get());
    
    simulation_start_time = k_uptime_get_32();
    
    /* Initialize timing subsystem */
    timing_init();
    LOG_INF("Timing subsystem initialized");
    
    /* Initialize critical tasks */
    init_critical_tasks();
    
    /* Start periodic simulation monitoring */
    k_timer_start(&simulation_timer, K_SECONDS(1), K_SECONDS(1));
    
    LOG_INF("All tasks initialized. Starting simulation for %d seconds...", 
            SIMULATION_DURATION_SEC);
    
    /* Start timing analysis */
    start_timing_analysis();
    
    /* Wait for simulation completion */
    while (simulation_running) {
        k_msleep(100);
    }
    
    /* Stop the simulation timer */
    k_timer_stop(&simulation_timer);
    
    LOG_INF("=== Mission Critical Scheduler Simulation Completed ===");
    
    return 0;
}
```

## src/critical_tasks.c
```c
/*
* Critical tasks implementations and utilities
*
* Additional critical task implementations and utilities
*/

#include <zephyr/kernel.h>
#include <zephyr/logging/log.h>
#include <zephyr/timing/timing.h>
#include <zephyr/sys/printk.h>
#include <zephyr/random/random.h>

LOG_MODULE_REGISTER(critical_tasks, LOG_LEVEL_DBG);

// External variables from main.c
extern struct k_mutex resource_mutex;
extern struct k_sem task_sync_sem;
extern volatile bool simulation_running;

// Additional critical task definitions
#define SAFETY_MONITOR_PRIORITY    2
#define FAULT_HANDLER_PRIORITY     1
#define EMERGENCY_TASK_PRIORITY    0  // Highest possible priority

#define CRITICAL_STACK_SIZE 1024

// Function prototypes
void emergency_response_task(void *arg1, void *arg2, void *arg3);
void safety_monitor_task(void *arg1, void *arg2, void *arg3);
void fault_detection_task(void *arg1, void *arg2, void *arg3);

// Emergency response task
K_THREAD_DEFINE(emergency_tid, CRITICAL_STACK_SIZE,
                emergency_response_task, NULL, NULL, NULL,
                EMERGENCY_TASK_PRIORITY, 0, 0);

// Safety monitor task
K_THREAD_DEFINE(safety_monitor_tid, CRITICAL_STACK_SIZE,
                safety_monitor_task, NULL, NULL, NULL,
                SAFETY_MONITOR_PRIORITY, 0, 0);

// Fault detection task
K_THREAD_DEFINE(fault_detector_tid, CRITICAL_STACK_SIZE,
                fault_detection_task, NULL, NULL, NULL,
                FAULT_HANDLER_PRIORITY, 0, 0);

// Critical system events
K_EVENT_DEFINE(system_events);

#define EVENT_EMERGENCY_STOP    BIT(0)
#define EVENT_SYSTEM_FAULT      BIT(1)
#define EVENT_SAFETY_VIOLATION  BIT(2)
#define EVENT_RESOURCE_CRITICAL BIT(3)

static uint32_t emergency_responses = 0;
static uint32_t safety_violations = 0;
static uint32_t fault_detections = 0;

void emergency_response_task(void *arg1, void *arg2, void *arg3)
{
    ARG_UNUSED(arg1);
    ARG_UNUSED(arg2);
    ARG_UNUSED(arg3);

    uint32_t events;
    timing_t response_start, response_end;
    uint64_t response_time;

    LOG_INF("Emergency Response Task started - Priority: %d", EMERGENCY_TASK_PRIORITY);

    while (simulation_running) {
        // Wait for emergency events
        events = k_event_wait(&system_events, 
                              EVENT_EMERGENCY_STOP | EVENT_SYSTEM_FAULT,
                              false, K_MSEC(1000));
        
        if (events) {
            response_start = timing_counter_get();
            
            LOG_DBG("Emergency Response: Handling events: 0x%08X", events);
            
            if (events & EVENT_EMERGENCY_STOP) {
                LOG_ERR("EMERGENCY: STOP command received!");
                // Simulate emergency stop sequence
                k_busy_wait(1000); // 1ms critical response
            }
            
            if (events & EVENT_SYSTEM_FAULT) {
                LOG_ERR("EMERGENCY: System fault detected!");
                // Simulate fault recovery
                k_busy_wait(2000); // 2ms fault handling
            }
            
            response_end = timing_counter_get();
            response_time = timing_cycles_to_ns(response_end - response_start);
            
            LOG_INF("EMERGENCY: Response completed in %llu ns", response_time);
            emergency_responses++;
            
            // Clear handled events
            k_event_clear(&system_events, events);
        }
    }
    
    LOG_INF("Emergency Response Task handled %u emergencies", emergency_responses);
}

void safety_monitor_task(void *arg1, void *arg2, void *arg3)
{
    ARG_UNUSED(arg1);
    ARG_UNUSED(arg2);
    ARG_UNUSED(arg3);

    uint32_t monitor_cycles = 0;
    timing_t monitor_start, monitor_end;
    uint64_t monitor_time;

    LOG_INF("Safety Monitor Task started - Priority: %d", SAFETY_MONITOR_PRIORITY);

    while (simulation_running) {
        monitor_start = timing_counter_get();
        
        LOG_DBG("Safety Monitor: Cycle %u - Checking system parameters", monitor_cycles);
        
        // Simulate safety parameter monitoring
        k_busy_wait(1500); // 1.5ms monitoring overhead
        
        // Periodically trigger safety events for testing
        if ((monitor_cycles % 100) == 0 && monitor_cycles > 0) {
            LOG_WRN("Safety Monitor: Safety violation detected!");
            k_event_post(&system_events, EVENT_SAFETY_VIOLATION);
            safety_violations++;
        }
        
        // Trigger emergency events occasionally
        if ((monitor_cycles % 300) == 0 && monitor_cycles > 0) {
            LOG_ERR("Safety Monitor: Critical fault - triggering emergency!");
            k_event_post(&system_events, EVENT_SYSTEM_FAULT);
        }
        
        monitor_end = timing_counter_get();
        monitor_time = timing_cycles_to_ns(monitor_end - monitor_start);
        
        if (monitor_time > 5000000) { // 5ms threshold
            LOG_WRN("Safety Monitor: Monitoring cycle took %llu ns (>5ms)", monitor_time);
        }
        
        LOG_INF("SAFETY: Monitor cycle %u completed - Thread %p", 
                monitor_cycles, k_current_get());
        
        monitor_cycles++;
        k_msleep(25); // 40Hz monitoring rate
    }
    
    LOG_INF("Safety Monitor Task completed %u cycles, detected %u violations", 
            monitor_cycles, safety_violations);
}

void fault_detection_task(void *arg1, void *arg2, void *arg3)
{
    ARG_UNUSED(arg1);
    ARG_UNUSED(arg2);
    ARG_UNUSED(arg3);

    uint32_t detection_cycles = 0;
    uint32_t false_positives = 0;

    LOG_INF("Fault Detection Task started - Priority: %d", FAULT_HANDLER_PRIORITY);

    while (simulation_running) {
        LOG_DBG("Fault Detection: Scanning cycle %u", detection_cycles);
        
        // Simulate fault detection algorithms
        k_busy_wait(4000); // 4ms detection processing
        
        // Simulate occasional fault detection
        if ((detection_cycles % 150) == 0 && detection_cycles > 0) {
            // Acquire resource for fault analysis
            if (k_mutex_lock(&resource_mutex, K_MSEC(5)) == 0) {
                LOG_WRN("Fault Detector: Potential fault analyzed");
                
                // Simulate fault analysis
                k_busy_wait(3000); // 3ms analysis
                
                // Determine if it's a real fault or false positive
                if (sys_rand32_get() % 4 == 0) {
                    LOG_ERR("Fault Detector: Real fault confirmed!");
                    k_event_post(&system_events, EVENT_SYSTEM_FAULT);
                    fault_detections++;
                } else {
                    LOG_DBG("Fault Detector: False positive detected");
                    false_positives++;
                }
                
                k_mutex_unlock(&resource_mutex);
            } else {
                LOG_WRN("Fault Detector: Could not acquire mutex for analysis");
            }
        }
        
        LOG_INF("FAULT: Detection cycle %u - Thread %p", 
                detection_cycles, k_current_get());
        
        detection_cycles++;
        k_msleep(40); // 25Hz detection rate
    }
    
    LOG_INF("Fault Detection Task completed %u cycles, found %u faults, %u false positives", 
            detection_cycles, fault_detections, false_positives);
}

void init_critical_tasks(void)
{
    LOG_INF("Initializing critical tasks and event system...");

    // Initialize system events
    k_event_init(&system_events);

    // Set thread names for better debugging
    k_thread_name_set(emergency_tid, "emergency_response");
    k_thread_name_set(safety_monitor_tid, "safety_monitor");
    k_thread_name_set(fault_detector_tid, "fault_detector");

    LOG_INF("Critical tasks initialized");
    LOG_INF("Emergency Response Priority: %d", EMERGENCY_TASK_PRIORITY);
    LOG_INF("Safety Monitor Priority: %d", SAFETY_MONITOR_PRIORITY);
    LOG_INF("Fault Detection Priority: %d", FAULT_HANDLER_PRIORITY);
}
```

## src/mission_critical.h
```c
/*
* Mission Critical Scheduler - Common Definitions
*
* Common constants, structures, and function declarations
*/

#ifndef MISSION_CRITICAL_H
#define MISSION_CRITICAL_H

#include <zephyr/kernel.h>

// Task function declarations
void mission_control_task(void *arg1, void *arg2, void *arg3);
void navigation_task(void *arg1, void *arg2, void *arg3);
void communication_task(void *arg1, void *arg2, void *arg3);
void housekeeping_task(void *arg1, void *arg2, void *arg3);

// Critical task function declarations
void emergency_response_task(void *arg1, void *arg2, void *arg3);
void safety_monitor_task(void *arg1, void *arg2, void *arg3);
void fault_detection_task(void *arg1, void *arg2, void *arg3);

// Timing analysis function declarations
void timing_analysis_work_handler(struct k_work *work);
void timing_analysis_timer_handler(struct k_timer *timer);

// Utility function declarations
void init_critical_tasks(void);
void start_timing_analysis(void);
void log_scheduler_state(void);
void analyze_memory_usage(void);
void analyze_thread_states(void);

// Shared resources
extern struct k_mutex resource_mutex;
extern struct k_sem task_sync_sem;
extern volatile bool simulation_running;

// Task priorities (using preemptive priorities 0-15, where 0=highest)
#define CRITICAL_TASK_PRIORITY      K_PRIO_PREEMPT(2)
#define HIGH_PRIORITY_TASK         K_PRIO_PREEMPT(5) 
#define MEDIUM_PRIORITY_TASK       K_PRIO_PREEMPT(8)
#define LOW_PRIORITY_TASK          K_PRIO_PREEMPT(12)

// Critical task priorities (highest priority preemptive)
#define SAFETY_MONITOR_PRIORITY    K_PRIO_PREEMPT(3)
#define FAULT_HANDLER_PRIORITY     K_PRIO_PREEMPT(1)
#define EMERGENCY_TASK_PRIORITY    K_PRIO_PREEMPT(0)

// Stack sizes
#define TASK_STACK_SIZE 2048
#define CRITICAL_STACK_SIZE 1024

// Timing constants
#define DEADLINE_MS 100
#define SIMULATION_DURATION_SEC 30

// Thread state constants for modern Zephyr
#define THREAD_STATE_CREATED    0
#define THREAD_STATE_READY      1
#define THREAD_STATE_RUNNING    2
#define THREAD_STATE_SUSPENDED  3
#define THREAD_STATE_TERMINATED 4

#endif /* MISSION_CRITICAL_H */
```

## src/timing_analysis.c
```c
/*
 * Timing Analysis and Scheduler Monitoring
 * 
 * This module provides detailed timing analysis and scheduler state monitoring
 * for mission-critical applications.
 */

#include <zephyr/kernel.h>
#include <zephyr/logging/log.h>
#include <zephyr/timing/timing.h>
#include <zephyr/sys/printk.h>
#include <zephyr/kernel_structs.h>

LOG_MODULE_REGISTER(timing_analysis, LOG_LEVEL_DBG);

// Timing analysis structures 
struct task_timing_stats {
    const char *task_name;
    struct k_thread *thread;
    uint64_t total_runtime_ns;
    uint64_t max_execution_ns;
    uint64_t min_execution_ns;
    uint32_t context_switches;
    uint32_t deadline_misses;
    uint32_t execution_count;
};

// Timing analysis configuration
#define MAX_MONITORED_TASKS 10
#define ANALYSIS_INTERVAL_MS 5000
#define DEADLINE_THRESHOLD_NS 50000000  // 50ms

static struct task_timing_stats task_stats[MAX_MONITORED_TASKS];
static uint32_t monitored_task_count = 0;
static timing_t last_analysis_time;
static uint64_t total_context_switches = 0;

// External variables
extern volatile bool simulation_running;
extern struct k_thread mission_control_tid;
extern struct k_thread navigation_tid;
extern struct k_thread communication_tid;
extern struct k_thread housekeeping_tid;
extern struct k_thread emergency_tid;
extern struct k_thread safety_monitor_tid;
extern struct k_thread fault_detector_tid;

// Function prototypes
void timing_analysis_work_handler(struct k_work *work);
void timing_analysis_timer_handler(struct k_timer *timer);
void analyze_memory_usage(void);
void analyze_thread_states(void);

// Analysis timer and work queue
K_WORK_DEFINE(timing_analysis_work, timing_analysis_work_handler);
K_TIMER_DEFINE(analysis_timer, timing_analysis_timer_handler, NULL);

// Context switch hook for detailed monitoring
static timing_t last_context_switch_time;
static struct k_thread *last_running_thread = NULL;

void timing_analysis_timer_handler(struct k_timer *timer)
{
    ARG_UNUSED(timer);
    k_work_submit(&timing_analysis_work);
}

void timing_analysis_work_handler(struct k_work *work)
{
    ARG_UNUSED(work);

    /* Don't run analysis if simulation is not running */
    if (!simulation_running) {
        return;
    }

    timing_t current_time = timing_counter_get();
    uint64_t analysis_interval_ns = timing_cycles_to_ns(current_time - last_analysis_time);

    LOG_INF("=== TIMING ANALYSIS REPORT ===");
    LOG_INF("Analysis interval: %llu ms", analysis_interval_ns / 1000000);

    // Print detailed statistics for each monitored task
    for (uint32_t i = 0; i < monitored_task_count; i++) 
    {
        struct task_timing_stats *stats = &task_stats[i];

        /* Safety checks */
        if (!stats || !stats->thread) {
            continue;
        }

        if( stats->execution_count > 0 ) {
            uint64_t avg_execution_ns = stats->total_runtime_ns / stats->execution_count;
            
            LOG_INF("Task %u:", i);
            LOG_INF("  Executions: %u", stats->execution_count);
            LOG_INF("  Avg execution: %llu µs", avg_execution_ns / 1000);
            LOG_INF("  Max execution: %llu µs", stats->max_execution_ns / 1000);
            LOG_INF("  Min execution: %llu µs", stats->min_execution_ns / 1000);
            LOG_INF("  Context switches: %u", stats->context_switches);
            LOG_INF("  Deadline misses: %u", stats->deadline_misses);
            LOG_INF("  Priority: %d", k_thread_priority_get(stats->thread));
        }
    }

    // System-wide scheduler statistics
    LOG_INF("=== SCHEDULER STATISTICS ===");
    LOG_INF("Total context switches: %llu", total_context_switches);
    LOG_INF("Current thread: %p", k_current_get());
    LOG_INF("System uptime: %u ms", k_uptime_get_32());

    // memory usage analysis
    analyze_memory_usage();

    // thread state analysis
    analyze_thread_states();

    last_analysis_time = current_time;
}

void analyze_memory_usage(void)
{
    LOG_INF("=== MEMORY USAGE ANALYSIS ===");
    
    /* Basic system info only - avoid all memory access that could cause crashes */
    LOG_INF("System memory analysis (safe mode)");
    
    if (monitored_task_count == 0) {
        LOG_WRN("No monitored tasks for memory analysis");
        return;
    }
    
    LOG_INF("Memory analysis for %u monitored tasks (basic info only)", monitored_task_count);
    
    /* Report basic task count and avoid all stack analysis to prevent crashes */
    for (uint32_t i = 0; i < monitored_task_count; i++) {
        struct task_timing_stats *stats = &task_stats[i];
        
        /* Minimal safety checks */
        if (!stats) {
            LOG_WRN("NULL stats at index %u", i);
            continue;
        }
        
        /* Only log basic task information without accessing thread memory */
        LOG_INF("Task %u: monitored (thread ptr: %p)", i, stats->thread);
    }
    
    LOG_INF("Memory analysis complete (safe mode - no memory inspection)");
}

void analyze_thread_states(void)
{
    LOG_INF("=== THREAD STATE ANALYSIS ===");
    
    for (uint32_t i = 0; i < monitored_task_count; i++) {
        struct task_timing_stats *stats = &task_stats[i];
        
        /* Safety checks */
        if (!stats || !stats->thread) {
            LOG_WRN("Invalid task stats at index %u in thread state analysis", i);
            continue;
        }
        
        /* Use only safe API calls, avoid direct memory access */
        int priority = k_thread_priority_get(stats->thread);
        
        /* Report basic thread information without accessing internal state */
        LOG_INF("Thread %u: Priority=%d (safe mode analysis)", i, priority);
    }
}

static void add_monitored_task(const char *name, struct k_thread *thread)
{
    if (monitored_task_count < MAX_MONITORED_TASKS) {
        struct task_timing_stats *stats = &task_stats[monitored_task_count];
        
        stats->task_name = name;
        stats->thread = thread;
        stats->total_runtime_ns = 0;
        stats->max_execution_ns = 0;
        stats->min_execution_ns = UINT64_MAX;
        stats->context_switches = 0;
        stats->deadline_misses = 0;
        stats->execution_count = 0;
        
        monitored_task_count++;
        
        LOG_INF("Added task '%s' to timing analysis", name);
    } else {
        LOG_WRN("Cannot add task '%s' - maximum monitored tasks reached", name);
    }
}

void record_task_execution(struct k_thread *thread, uint64_t execution_time_ns)
{
    for (uint32_t i = 0; i < monitored_task_count; i++) {
        struct task_timing_stats *stats = &task_stats[i];
        
        if (stats->thread == thread) {
            stats->total_runtime_ns += execution_time_ns;
            stats->execution_count++;
            
            if (execution_time_ns > stats->max_execution_ns) {
                stats->max_execution_ns = execution_time_ns;
            }
            
            if (execution_time_ns < stats->min_execution_ns) {
                stats->min_execution_ns = execution_time_ns;
            }
            
            if (execution_time_ns > DEADLINE_THRESHOLD_NS) {
                stats->deadline_misses++;
                LOG_WRN("Deadline miss detected for %s: %llu µs", 
                        stats->task_name, execution_time_ns / 1000);
            }
            
            break;
        }
    }
}

void record_context_switch(struct k_thread *prev_thread, struct k_thread *next_thread)
{
    ARG_UNUSED(prev_thread);
    
    total_context_switches++;
    
    /* Update context switch count for the incoming thread */
    for (uint32_t i = 0; i < monitored_task_count; i++) {
        if (task_stats[i].thread == next_thread) {
            task_stats[i].context_switches++;
            break;
        }
    }
    
    timing_t current_time = timing_counter_get();
    
    /* Calculate execution time for the previous thread */
    if (last_running_thread != NULL && last_context_switch_time != 0) {
        uint64_t execution_time = timing_cycles_to_ns(current_time - last_context_switch_time);
        record_task_execution(last_running_thread, execution_time);
    }
    
    last_context_switch_time = current_time;
    last_running_thread = next_thread;
    
    LOG_DBG("Context switch: %p -> %p (total: %llu)", 
            prev_thread, next_thread, total_context_switches);
}

void start_timing_analysis(void)
{
    LOG_INF("Starting comprehensive timing analysis...");
    
    /* Wait for threads to initialize */
    k_sleep(K_MSEC(1000));
    
    /* Initialize timing system */
    last_analysis_time = timing_counter_get();
    last_context_switch_time = last_analysis_time;
    
    /* Add all critical tasks to monitoring */
    add_monitored_task("mission_control", &mission_control_tid);
    add_monitored_task("navigation", &navigation_tid);
    add_monitored_task("communication", &communication_tid);
    add_monitored_task("housekeeping", &housekeeping_tid);
    add_monitored_task("emergency", &emergency_tid);
    add_monitored_task("safety_monitor", &safety_monitor_tid);
    add_monitored_task("fault_detector", &fault_detector_tid);
    
    /* Start periodic analysis timer with initial delay */
    k_timer_start(&analysis_timer, K_MSEC(ANALYSIS_INTERVAL_MS + 1000), K_MSEC(ANALYSIS_INTERVAL_MS));
    
    LOG_INF("Timing analysis started - reporting every %d ms", ANALYSIS_INTERVAL_MS);
    LOG_INF("Monitoring %u tasks with deadline threshold: %u µs", 
            monitored_task_count, DEADLINE_THRESHOLD_NS / 1000);
}
```
