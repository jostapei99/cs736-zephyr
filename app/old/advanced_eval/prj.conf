## prj.conf
```kconfig
# Enable custom scheduler infrastructure
CONFIG_736=y
CONFIG_736_TIME_LEFT=y

# Required base config for deadline/weight fields
CONFIG_SCHED_DEADLINE=y

# Tickless kernel for accurate timing
CONFIG_TICKLESS_KERNEL=y

# Thread runtime statistics
CONFIG_SCHED_THREAD_USAGE=y
CONFIG_THREAD_RUNTIME_STATS=y
CONFIG_SCHED_THREAD_USAGE_AUTO_ENABLE=n
CONFIG_SCHED_THREAD_USAGE_ALL=n

# Scheduler selection (enable ONLY ONE at a time)
# Standard EDF uses CONFIG_SCHED_DEADLINE alone
CONFIG_736_MOD_EDF=y                # Weighted EDF
# CONFIG_736_WSRT=y                 # Weighted Shortest Remaining Time  
# CONFIG_736_RMS=y                  # Rate Monotonic Scheduling

# Console output
CONFIG_PRINTK=y
CONFIG_CONSOLE=y

# Enable floating point printf support
CONFIG_CBPRINTF_FP_SUPPORT=y

# Shell support for runtime control
CONFIG_SHELL=y
CONFIG_SHELL_BACKEND_SERIAL=y
CONFIG_SHELL_PROMPT_UART="rt_eval:~$ "
CONFIG_SHELL_CMD_BUFF_SIZE=256
CONFIG_SHELL_PRINTF_BUFF_SIZE=256

# Enable additional thread info
CONFIG_THREAD_NAME=y
CONFIG_THREAD_STACK_INFO=y
CONFIG_THREAD_MONITOR=y

# Enable system workqueue (for shell)
CONFIG_SYSTEM_WORKQUEUE_STACK_SIZE=2048

# Increase main stack for shell
CONFIG_MAIN_STACK_SIZE=4096

# Enable assertions for debugging
CONFIG_ASSERT=y
CONFIG_ASSERT_LEVEL=2

# Enable more detailed timing
CONFIG_TIMER_READS_ITS_FREQUENCY_AT_RUNTIME=y
```

## include/metrics.h
```c
#ifndef METRICS_H
#define METRICS_H

#include <stdint.h>
#include <stdbool.h>
#include "workloads.h"

/* Extended stats structure with advanced metrics */
typedef struct {
    /* Basic timing */
    uint64_t next_release;
    uint32_t activations;
    uint32_t deadline_misses;
    
    /* Response time statistics */
    uint32_t total_response_time;
    uint64_t sum_response_time_squared;
    uint32_t min_response_time;
    uint32_t max_response_time;
    
    /* Jitter metrics */
    double response_time_variance;
    double response_time_std_dev;
    
    /* Execution time tracking */
    uint32_t total_exec_time;
    uint32_t min_exec_time;
    uint32_t max_exec_time;
    
    /* Advanced metrics */
    uint32_t preemptions;
    uint32_t context_switches;
    uint64_t total_lateness;    /* Sum of all lateness */
    uint32_t max_lateness;
    
    /* CPU cycles (if available) */
    uint64_t total_cycles;
    
} task_stats_t;

/* System-wide metrics */
typedef struct {
    uint64_t system_start_time;
    uint64_t total_runtime;
    uint32_t total_activations;
    uint32_t total_deadline_misses;
    double system_utilization;
    uint32_t total_preemptions;
} system_metrics_t;

/* Output format options */
typedef enum {
    OUTPUT_CSV,
    OUTPUT_JSON,
    OUTPUT_HUMAN,
    OUTPUT_QUIET
} output_format_t;

/* Global metrics */
extern system_metrics_t system_metrics;
extern output_format_t output_format;

/* Function declarations */
void metrics_init(void);
void metrics_update(task_stats_t *stats, uint32_t response_time, 
                   uint32_t exec_time, bool deadline_met, uint32_t lateness);
void metrics_calculate_jitter(task_stats_t *stats);
void metrics_print_task_summary(uint32_t task_id, const task_config_t *cfg, 
                               const task_stats_t *stats);
void metrics_print_system_summary(void);
void metrics_print_csv_header(void);
void metrics_print_csv_record(uint64_t timestamp, uint32_t task_id,
                              const task_stats_t *stats, uint32_t response_time,
                              bool deadline_met, int32_t lateness,
                              const task_config_t *cfg);
void metrics_print_json_record(uint64_t timestamp, uint32_t task_id,
                              const task_stats_t *stats, uint32_t response_time,
                              bool deadline_met, int32_t lateness,
                              const task_config_t *cfg);

#endif /* METRICS_H */
```

## src/shell_commands.c
```c
#include <zephyr/kernel.h>
#include <zephyr/shell/shell.h>
#include <stdlib.h>
#include "workloads.h"
#include "metrics.h"

/* External references */
extern task_config_t task_configs[];
extern task_stats_t task_stats[];
extern bool tasks_running;

/**
 * Shell command: show - Display current configuration
 */
static int cmd_show(const struct shell *sh, size_t argc, char **argv)
{
    ARG_UNUSED(argc);
    ARG_UNUSED(argv);
    
    shell_print(sh, "\n═══════════════════════════════════════════════════");
    shell_print(sh, "Current Workload: %s", workload_name);
    shell_print(sh, "═══════════════════════════════════════════════════");
    
    float total_util = 0.0f;
    for (int i = 0; i < NUM_TASKS; i++) {
        const task_config_t *cfg = &task_configs[i];
        float util = cfg->exec_time_ms / (float)cfg->period_ms;
        total_util += util;
        
        shell_print(sh, "%s: P=%ums E=%ums D=%ums W=%u (%.1f%%)",
                   cfg->name, cfg->period_ms, cfg->exec_time_ms,
                   cfg->deadline_ms, cfg->weight, 100.0f * util);
    }
    
    shell_print(sh, "───────────────────────────────────────────────────");
    shell_print(sh, "Total Utilization: %.1f%%", 100.0f * total_util);
    shell_print(sh, "═══════════════════════════════════════════════════\n");
    
    return 0;
}

/**
 * Shell command: stats - Display runtime statistics
 */
static int cmd_stats(const struct shell *sh, size_t argc, char **argv)
{
    ARG_UNUSED(argc);
    ARG_UNUSED(argv);
    
    shell_print(sh, "\n═══════════════════════════════════════════════════");
    shell_print(sh, "Runtime Statistics");
    shell_print(sh, "═══════════════════════════════════════════════════");
    
    for (int i = 0; i < NUM_TASKS; i++) {
        const task_stats_t *stats = &task_stats[i];
        const task_config_t *cfg = &task_configs[i];
        
        if (stats->activations == 0) {
            shell_print(sh, "%s: No activations yet", cfg->name);
            continue;
        }
        
        uint32_t avg_rt = stats->total_response_time / stats->activations;
        double miss_rate = 100.0 * stats->deadline_misses / stats->activations;
        
        shell_print(sh, "%s: Act=%u Miss=%u (%.1f%%) AvgRT=%ums Jitter=%.2fms",
                   cfg->name, stats->activations, stats->deadline_misses,
                   miss_rate, avg_rt, stats->response_time_std_dev);
    }
    
    shell_print(sh, "═══════════════════════════════════════════════════\n");
    
    return 0;
}

/**
 * Shell command: format - Change output format
 */
static int cmd_format(const struct shell *sh, size_t argc, char **argv)
{
    if (argc < 2) {
        shell_print(sh, "Usage: format <csv|json|human|quiet>");
        shell_print(sh, "Current format: %s", 
                   output_format == OUTPUT_CSV ? "csv" :
                   output_format == OUTPUT_JSON ? "json" :
                   output_format == OUTPUT_HUMAN ? "human" : "quiet");
        return -1;
    }
    
    if (strcmp(argv[1], "csv") == 0) {
        output_format = OUTPUT_CSV;
        shell_print(sh, "Output format: CSV");
    } else if (strcmp(argv[1], "json") == 0) {
        output_format = OUTPUT_JSON;
        shell_print(sh, "Output format: JSON");
    } else if (strcmp(argv[1], "human") == 0) {
        output_format = OUTPUT_HUMAN;
        shell_print(sh, "Output format: Human-readable");
    } else if (strcmp(argv[1], "quiet") == 0) {
        output_format = OUTPUT_QUIET;
        shell_print(sh, "Output format: Quiet");
    } else {
        shell_error(sh, "Unknown format: %s", argv[1]);
        return -1;
    }
    
    return 0;
}

/**
 * Shell command: set - Modify task parameters at runtime
 */
static int cmd_set(const struct shell *sh, size_t argc, char **argv)
{
    if (argc < 4) {
        shell_print(sh, "Usage: set <task_id> <param> <value>");
        shell_print(sh, "  task_id: 1-%d", NUM_TASKS);
        shell_print(sh, "  param: period|exec|deadline|weight");
        shell_print(sh, "  value: integer value");
        return -1;
    }
    
    int task_id = atoi(argv[1]);
    if (task_id < 1 || task_id > NUM_TASKS) {
        shell_error(sh, "Invalid task_id: %d (must be 1-%d)", task_id, NUM_TASKS);
        return -1;
    }
    
    task_config_t *cfg = &task_configs[task_id - 1];
    int value = atoi(argv[3]);
    
    if (value <= 0) {
        shell_error(sh, "Invalid value: %d", value);
        return -1;
    }
    
    if (strcmp(argv[2], "period") == 0) {
        cfg->period_ms = value;
        shell_print(sh, "%s period set to %u ms", cfg->name, value);
    } else if (strcmp(argv[2], "exec") == 0) {
        cfg->exec_time_ms = value;
        shell_print(sh, "%s exec_time set to %u ms", cfg->name, value);
    } else if (strcmp(argv[2], "deadline") == 0) {
        cfg->deadline_ms = value;
        shell_print(sh, "%s deadline set to %u ms", cfg->name, value);
    } else if (strcmp(argv[2], "weight") == 0) {
        cfg->weight = value;
        shell_print(sh, "%s weight set to %u", cfg->name, value);
    } else {
        shell_error(sh, "Unknown parameter: %s", argv[2]);
        return -1;
    }
    
    return 0;
}

/**
 * Shell command: reset - Reset statistics
 */
static int cmd_reset(const struct shell *sh, size_t argc, char **argv)
{
    ARG_UNUSED(argc);
    ARG_UNUSED(argv);
    
    for (int i = 0; i < NUM_TASKS; i++) {
        task_stats[i].activations = 0;
        task_stats[i].deadline_misses = 0;
        task_stats[i].total_response_time = 0;
        task_stats[i].sum_response_time_squared = 0;
        task_stats[i].total_exec_time = 0;
        task_stats[i].total_lateness = 0;
    }
    
    metrics_init();
    shell_print(sh, "Statistics reset");
    
    return 0;
}

/**
 * Shell command: util - Calculate and display utilization
 */
static int cmd_util(const struct shell *sh, size_t argc, char **argv)
{
    ARG_UNUSED(argc);
    ARG_UNUSED(argv);
    
    float total_util = 0.0f;
    shell_print(sh, "\nTask Utilization:");
    
    for (int i = 0; i < NUM_TASKS; i++) {
        const task_config_t *cfg = &task_configs[i];
        float util = cfg->exec_time_ms / (float)cfg->period_ms;
        total_util += util;
        
        shell_print(sh, "  %s: %.2f%% (C=%u, T=%u)",
                   cfg->name, 100.0f * util, cfg->exec_time_ms, cfg->period_ms);
    }
    
    shell_print(sh, "Total: %.2f%%", 100.0f * total_util);
    
    if (total_util <= 1.0) {
        shell_print(sh, "Status: Schedulable");
    } else {
        shell_warn(sh, "Status: OVERLOADED!");
    }
    
    shell_print(sh, "");
    return 0;
}

/* Register shell commands */
SHELL_STATIC_SUBCMD_SET_CREATE(rt_eval_cmds,
    SHELL_CMD(show, NULL, "Show current configuration", cmd_show),
    SHELL_CMD(stats, NULL, "Display runtime statistics", cmd_stats),
    SHELL_CMD(format, NULL, "Set output format (csv|json|human|quiet)", cmd_format),
    SHELL_CMD(set, NULL, "Set task parameter (task_id param value)", cmd_set),
    SHELL_CMD(reset, NULL, "Reset statistics", cmd_reset),
    SHELL_CMD(util, NULL, "Show utilization analysis", cmd_util),
    SHELL_SUBCMD_SET_END
);

SHELL_CMD_REGISTER(rt, &rt_eval_cmds, "RT Scheduler Evaluation commands", NULL);
```
