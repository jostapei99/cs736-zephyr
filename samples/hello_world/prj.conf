## prj.conf
```kconfig
CONFIG_SCHED_DEADLINE=y
```

## src/main.c
```c
/*
 * Copyright (c) 2012-2014 Wind River Systems, Inc.
 *
 * SPDX-License-Identifier: Apache-2.0
 */

#include <zephyr/kernel.h>

int main(void)
{
printk("Hello World! %s\n", CONFIG_BOARD);
return 0;
}
```
